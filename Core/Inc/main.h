/* USER CODE BEGIN Header */
/**
  ******************************************************************************
  * @file           : main.h
  * @brief          : Header for main.c file.
  *                   This file contains the common defines of the application.
  ******************************************************************************
  * @attention
  *
  * Copyright (c) 2024 STMicroelectronics.
  * All rights reserved.
  *
  * This software is licensed under terms that can be found in the LICENSE file
  * in the root directory of this software component.
  * If no LICENSE file comes with this software, it is provided AS-IS.
  *
  ******************************************************************************
  */
/* USER CODE END Header */

/* Define to prevent recursive inclusion -------------------------------------*/
#ifndef __MAIN_H
#define __MAIN_H

#ifdef __cplusplus
extern "C" {
#endif

/* Includes ------------------------------------------------------------------*/
#include "stm32f1xx_hal.h"

/* Private includes ----------------------------------------------------------*/
/* USER CODE BEGIN Includes */

/* USER CODE END Includes */

/* Exported types ------------------------------------------------------------*/
/* USER CODE BEGIN ET */

/* USER CODE END ET */

/* Exported constants --------------------------------------------------------*/
/* USER CODE BEGIN EC */

// LUT to make the pot feel more "linear". The led has an exp i/v curve so y is a ln(x) function to make the
//		pot value roughly proportional to the LED intensity/ current
static const float y[512] = {
    0.000000, 0.007582, 0.015035, 0.022361, 0.029566, 0.036654, 0.043628, 0.050491,
    0.057248, 0.063901, 0.070454, 0.076909, 0.083270, 0.089539, 0.095719, 0.101812,
    0.107820, 0.113747, 0.119594, 0.125363, 0.131057, 0.136677, 0.142225, 0.147704,
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    0.994612, 0.995386, 0.996159, 0.996930, 0.997699, 0.998467, 0.999234, 1.000000,
};

// LUT to maintain a good brightness roll off at low brightnesses
static const float spreadRollOff[512] = {
    0.013333, 0.026667, 0.040000, 0.053333, 0.066667, 0.080000, 0.093333, 0.106667,
    0.120000, 0.133333, 0.146667, 0.160000, 0.173333, 0.186667, 0.200000, 0.213333,
    0.226667, 0.240000, 0.253333, 0.266667, 0.280000, 0.293333, 0.306667, 0.320000,
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    1.000000, 1.000000, 1.000000, 1.000000, 1.000000, 1.000000, 1.000000, 1.000000,
};

/* ----- MATLAB code to generate these LUTS
	% MATLAB code to create a lookup table for ln(x)
	% Define the x range and preallocate the lookup table
	x = linspace(1, 10, 512);
	y = log(x);
	y = y/max(y);
	plot(x,y)

	t = 1:512;
	spreadRollOff = t/75;
	spreadRollOff(spreadRollOff > 1) = 1;
	plot(t, spreadRollOff)

	% Print out LUT for log function
	disp('const float y[512] = {')
	for i = 1:8:length(y)
		fprintf('    ')
		fprintf('%.6f, ', y(i:min(i+7, end)))
		fprintf('\n')
	end
	disp('};')

	% Print out LUT for roll off factor
	disp('const float spreadRollOff[512] = {')
	for i = 1:8:length(y)
		fprintf('    ')
		fprintf('%.6f, ', spreadRollOff(i:min(i+7, end)))
		fprintf('\n')
	end
	disp('};')
 */
/* USER CODE END EC */

/* Exported macro ------------------------------------------------------------*/
/* USER CODE BEGIN EM */

/* USER CODE END EM */

void HAL_TIM_MspPostInit(TIM_HandleTypeDef *htim);

/* Exported functions prototypes ---------------------------------------------*/
void Error_Handler(void);

/* USER CODE BEGIN EFP */

/* USER CODE END EFP */

/* Private defines -----------------------------------------------------------*/
#define CLOCK_PERIOD 1200

/* USER CODE BEGIN Private defines */

/* USER CODE END Private defines */

#ifdef __cplusplus
}
#endif

#endif /* __MAIN_H */
